## firmware/zephyr/boards/elecrow/thinknode_m1/board.yml
```yaml
board:
  name: thinknode_m1
  full_name: Elecrow ThinkNode M1
  vendor: elecrow
  socs:
    - name: nrf52840
```

## firmware/zephyr/boards/elecrow/thinknode_m1/thinknode_m1_defconfig
```kconfig
CONFIG_ARM_MPU=y
CONFIG_GPIO=y
CONFIG_SERIAL=y
CONFIG_USE_DT_CODE_PARTITION=y
CONFIG_CLOCK_CONTROL_NRF_K32SRC_XTAL=y
```
